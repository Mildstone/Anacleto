## Kconfig
```kconfig
# ////////////////////////////////////////////////////////////////////////// //
#
# This file is part of the anacleto project.
# Copyright 2018 Andrea Rigoni Garola <andrea.rigoni@igi.cnr.it>.
#
# This program is free software: you can redistribute it and/or modify
# it under the terms of the GNU General Public License as published by
# the Free Software Foundation, either version 3 of the License, or
# (at your option) any later version.
#
# This program is distributed in the hope that it will be useful,
# but WITHOUT ANY WARRANTY; without even the implied warranty of
# MERCHANTABILITY or FITNESS FOR A PARTICULAR PURPOSE.  See the
# GNU General Public License for more details.
#
# You should have received a copy of the GNU General Public License
# along with this program.  If not, see <http://www.gnu.org/licenses/>.
#
# ////////////////////////////////////////////////////////////////////////// //

#
# For a description of the syntax of this configuration file,
# see Documentation/kbuild/kconfig-language.txt.
#

mainmenu "Anacleto - GNU Linux build system for FPGA SoC devices"

# //////////////////////////////////////////////////////////////////////////// #
# //  BULD COMMON  /////////////////////////////////////////////////////////// #
# //////////////////////////////////////////////////////////////////////////// #

source conf/kscripts/build_common.kconfig

# //////////////////////////////////////////////////////////////////////////// #
# //  PYTHON  //////////////////////////////////////////////////////////////// #
# //////////////////////////////////////////////////////////////////////////// #

  source conf/kscripts/python.kconfig

# //////////////////////////////////////////////////////////////////////////// #
# //  TOOLCHAIN  ///////////////////////////////////////////////////////////// #
# //////////////////////////////////////////////////////////////////////////// #

source conf/kscripts/toolchain.kconfig


# //////////////////////////////////////////////////////////////////////////// #
# //  FPGA  ////////////////////////////////////////////////////////////////// #
# //////////////////////////////////////////////////////////////////////////// #

source fpga/Kconfig


# //////////////////////////////////////////////////////////////////////////// #
# //  LINUX  ///////////////////////////////////////////////////////////////// #
# //////////////////////////////////////////////////////////////////////////// #

source conf/kscripts/linux.kconfig


# //////////////////////////////////////////////////////////////////////////// #
# //  YOCTO  ///////////////////////////////////////////////////////////////// #
# //////////////////////////////////////////////////////////////////////////// #

source conf/kscripts/yocto.kconfig

if ENABLE_YOCTO

  config ENABLE_YOCTO_XILINX
	bool  "Enable Yocto meta-xilinx build"
	depends on ENABLE_YOCTO
	default "no"

  config YOCTO_XILINX_URL
	string  "Yocto meta-xilinx git repository"
	depends on ENABLE_YOCTO_XILINX
	default "https://github.com/Xilinx/meta-xilinx.git"


endif # ENABLE_YOCTO


# //////////////////////////////////////////////////////////////////////////// #
# //  DOCKER  //////////////////////////////////////////////////////////////// #
# //////////////////////////////////////////////////////////////////////////// #

source conf/kscripts/docker.kconfig


# //////////////////////////////////////////////////////////////////////////// #
# //  TARGET_DEVICE  ///////////////////////////////////////////////////////// #
# //////////////////////////////////////////////////////////////////////////// #

menu TARGET_DEVICE

	config DEVICE_NAME
		  string  "Enter device name"

	config DEVICE_IP
		  string  "Enter device IP address"

	config DEVICE_ACCESS
		  string  "Enter device access method"
		  default "sftp"

	config DEVICE_USER
		  string  "User to connect device with"
		  default "root"

	choice DEVICE_AUTHMETHOD
		  prompt "Select device authentication method"
		  config WITH_DEVICE_SSHPASSWD
		   bool "Auth on device using password"
		  config WITH_DEVICE_SSHKEY
		   bool "Auth on device using ssh keyid"
	endchoice

	config DEVICE_PASSWD
		  string  "User password to autenticate user"
		  depends on WITH_DEVICE_SSHPASSWD
		  default "root"

	config DEVICE_SSHKEY
		  string  "User rsa_key to autenticate"
		  depends on WITH_DEVICE_SSHKEY
		  default "$HOME/.ssh/id_rsa"

	config DEVICE_MODULES_DIR
		  string  "Target device modules directory"
		  default "/lib/modules"

	config DEVICE_BOOT_DIR
	  string  "Target device boot directory"
	  default "/boot"

endmenu # TARGET_DEVICE
```

## fpga/Kconfig
```kconfig
## ////////////////////////////////////////////////////////////////////////// //
##
## This file is part of the anacleto project.
## Copyright 2018 Andrea Rigoni Garola <andrea.rigoni@igi.cnr.it>.
##
## This program is free software: you can redistribute it and/or modify
## it under the terms of the GNU General Public License as published by
## the Free Software Foundation, either version 3 of the License, or
## (at your option) any later version.
##
## This program is distributed in the hope that it will be useful,
## but WITHOUT ANY WARRANTY; without even the implied warranty of
## MERCHANTABILITY or FITNESS FOR A PARTICULAR PURPOSE.  See the
## GNU General Public License for more details.
##
## You should have received a copy of the GNU General Public License
## along with this program.  If not, see <http://www.gnu.org/licenses/>.
##
## ////////////////////////////////////////////////////////////////////////// //



# //////////////////////////////////////////////////////////////////////////// #
# //  FPGA  ////////////////////////////////////////////////////////////////// #
# //////////////////////////////////////////////////////////////////////////// #

menuconfig ENABLE_FPGA
	bool "Enable FPGA development toolchain"
	default y

if ENABLE_FPGA

  ## ///////////////////////////////////////////////////////////////////////////
  ## //  PRESETS  //////////////////////////////////////////////////////////////
  ## ///////////////////////////////////////////////////////////////////////////
  menu "Enabled SOC boards"

  menuconfig ENABLE_BOARD_RED_PITAYA
	bool "STEMLab Red Pitaya"
	default y
  if ENABLE_BOARD_RED_PITAYA
	config red_pitaya_BOARD_PART
	 string "board part"
	 default "redpitaya.com:redpitaya:part0:1.1"
	config red_pitaya_BOARD_PRESET
	 string "Preset tcl"
	 default "${srcdir}/fpga/brd/red_pitaya/presets/zynq_rp1.1.tcl"
	config red_pitaya_VIVADO_SOC_PART
	 string "SoC part"
	 default "xc7z010clg400-1"
  endif

  menuconfig ENABLE_BOARD_ZYBO
	bool "Digilent Zybo"
	default y
  if ENABLE_BOARD_ZYBO
	config zybo_BOARD_PART
	 string "board part"
	 default "digilentinc.com:zybo:part0:1.0"
	config zybo_BOARD_PRESET
	 string "Preset tcl"
	 default "${srcdir}/fpga/brd/zybo/presets/ZYBO_C.tcl"
	config zybo_VIVADO_SOC_PART
	 string "SoC part"
	 default "xc7z010clg400-1"
  endif

  endmenu

  choice BOARD
	prompt "Default"
	config WITH_SOC_RED_PITAYA
	 depends on ENABLE_BOARD_RED_PITAYA
	 bool "red_pitaya"
	config WITH_SOC_ZYBO
	 depends on ENABLE_BOARD_ZYBO
	 bool "zybo"
	config WITH_SOC_CUSTOM
	 bool "custom"
  endchoice

  if WITH_SOC_CUSTOM
  config BOARD_PART
	string "board part"
  config BOARD_PRESET
	string "Board preset init template"
  config VIVADO_SOC_PART
   string "Vivado soc part"
   default "xc7z010clg400-1"
  endif # custom



## ////////////////////////////////////////////////////////////////////////////////
## //  VIVADO  ////////////////////////////////////////////////////////////////////
## ////////////////////////////////////////////////////////////////////////////////

  config VIVADO_VERSION
	string "Vivado version yyyy.v "
	default "2019.1"

  choice VIVADO_SETUP_METHOD
	prompt "Select Vivado setup method"
	config VIVADO_SETUP_METHOD_BASEPATH
	 bool "Xilinx base path"
	config VIVADO_SETUP_METHOD_SCRIPTS
	 bool "Setup scripts"
  endchoice

  if VIVADO_SETUP_METHOD_BASEPATH
  config XILINX_BASE_PATHDIR
	string "Setup the base Xilinx path directory"
	default "/opt/Xilinx"
  endif # BASEPATH

  if VIVADO_SETUP_METHOD_SCRIPTS
  config VIVADO_SETUP_SCRIPT
	string "Setup script to set vivado environments"
	default "/opt/Xilinx/Vivado/2019.1/settings64.sh"

  config VIVADO_SDK_SETUP_SCRIPT
	string "Setup script to set vivado SDK environments"
	default "/opt/Xilinx/SDK/2019.1/settings64.sh"
  endif # SCRIPTS

  config DEVICETREE_BASEFILES_TAR
	string "Device tree base files"
	default "https://github.com/Xilinx/device-tree-xlnx/archive/xilinx-v2019.1.tar.gz"


#  config VIVADO_LICENSE_PATH
#        string "Path to the vivado system folder"
#        default ""

endif # FPGA
```

## yocto/meta-anacleto-example/conf/layer.conf
```bitbake
# We have a conf and classes directory, add to BBPATH
BBPATH .= ":${LAYERDIR}"

# We have recipes-* directories, add to BBFILES
BBFILES += "${LAYERDIR}/recipes-*/*/*.bb \
            ${LAYERDIR}/recipes-*/*/*.bbappend"

BBFILE_COLLECTIONS += "meta-anacleto-example"
BBFILE_PATTERN_meta-anacleto-example = "^${LAYERDIR}/"
BBFILE_PRIORITY_meta-anacleto-example = "6"

LAYERDEPENDS_meta-anacleto-example = "core"
LAYERSERIES_COMPAT_meta-anacleto-example = "warrior zeus"
```
